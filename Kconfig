## Kconfig
```kconfig
# Copyright (c) 2025, Croxel Inc.
# SPDX-License-Identifier: Apache-2.0

menu "ZROS drivers"

rsource "drivers/Kconfig"
rsource "lib/Kconfig"

endmenu
```

## drivers/sense/Kconfig
```kconfig
# Copyright (c) 2025 Croxel Inc.
# SPDX-License-Identifier: Apache-2.0

menuconfig ZROS_SENSE
	bool "Enable Common ZROS Sense drivers"
	default y
	depends on ZROS
	help
	  ZROS Common Sense drivers

if ZROS_SENSE

rsource "baro/Kconfig"
rsource "imu/Kconfig"

endif
```

## drivers/sense/baro/Kconfig
```kconfig
# Copyright (c) 2023, CogniPilot Foundation
# Copyright (c) 2025 Croxel Inc.
# SPDX-License-Identifier: Apache-2.0

menuconfig ZROS_SENSE_BARO
  bool "ZROS Baro driver"
  help
    This option enables the barometric altimeter driver interface

if ZROS_SENSE_BARO

config ZROS_SENSE_BARO_COUNT
  int "Number of barometers"
  default 1
  range 1 4
  help
    Defines number of barometers 1-4

module = ZROS_SENSE_BARO
module-str = sense_baro
source "subsys/logging/Kconfig.template.log_config"

endif # ZROS_SENSE_BARO
```

## drivers/sense/gnss/Kconfig
```kconfig
# Copyright (c) 2025 Croxel Inc.
# SPDX-License-Identifier: Apache-2.0

config ZROS_SENSE_GNSS
	bool "ZROS Sense GNSS driver"
	select GNSS
	help
	  This option enables the GNSS ZROS driver

if ZROS_SENSE_GNSS

module = ZROS_SENSE_GNSS
module-str = sense_gnss
source "subsys/logging/Kconfig.template.log_config"

endif # ZROS_SENSE_GNSS
```

## drivers/sense/imu/Kconfig
```kconfig
# Copyright (c) 2023 CogniPilot Foundation
# Copyright (c) 2025 Croxel Inc.
# SPDX-License-Identifier: Apache-2.0

config ZROS_SENSE_IMU
	bool "ZROS IMU driver"
	default y
	help
	  This option enables the ZROS IMU driver interface

if ZROS_SENSE_IMU

config ZROS_SENSE_IMU_ACCEL_COUNT
  int "Number of accelerometers"
  default 1
  range 1 4
  help
    Defines number of accelerometers 1-4

config ZROS_SENSE_IMU_GYRO_COUNT
  int "Number of gyroscopes"
  default 1
  range 1 4
  help
    Defines number of gyroscopes 1-4

module = ZROS_SENSE_IMU
module-str = sense_imu
source "subsys/logging/Kconfig.template.log_config"

endif # ZROS_SENSE_IMU
```

## drivers/sense/mag/Kconfig
```kconfig
# Copyright (c) 2023, CogniPilot Foundation
# Copyright (c) 2025 Croxel Inc.
# SPDX-License-Identifier: Apache-2.0
menuconfig ZROS_SENSE_MAG
  bool "ZROS MAG driver"
  depends on ZROS
  help
    This option enables the MAG driver interface

if ZROS_SENSE_MAG

config ZROS_SENSE_MAG_COUNT
  int "Number of magnetometers"
  default 1
  range 1 4
  help
    Defines number of magnetometers 1-4

module = ZROS_SENSE_MAG
module-str = sense_mag
source "subsys/logging/Kconfig.template.log_config"

endif # ZROS_SENSE_MAG
```

## drivers/sense/rtcm3_sub/Kconfig
```kconfig
# Copyright (c) 2025 Croxel Inc.
# SPDX-License-Identifier: Apache-2.0

config ZROS_SENSE_RTCM3_SUB
	bool "ZROS Sense RTCM3 Subscriber driver"
	select GNSS
	select GNSS_RTK
	help
	  This option enables the RTCM3 Subscriber ZROS driver

if ZROS_SENSE_RTCM3_SUB

module = ZROS_SENSE_RTCM3_SUB
module-str = sense_rtcm3_sub
source "subsys/logging/Kconfig.template.log_config"

endif # ZROS_SENSE_RTCM3_SUB
```

## drivers/sense/stream/Kconfig
```kconfig
# Copyright (c) 2025 Croxel Inc.
# SPDX-License-Identifier: Apache-2.0

menuconfig ZROS_SENSE_STREAM
	bool "Enable ZROS Sense Stream drivers"
	help
	  ZROS Sense Stream drivers

if ZROS_SENSE_STREAM

rsource "imu/Kconfig"
rsource "mag/Kconfig"
rsource "optical_flow/Kconfig"

endif
```

## drivers/sense/stream/argus/Kconfig
```kconfig
# Copyright (c) 2023 CogniPilot Foundation
# Copyright (c) 2025 Croxel Inc.
# SPDX-License-Identifier: Apache-2.0

config ZROS_SENSE_STREAM_ARGUS
	bool "ZROS Argus Stream driver"
	select SENSOR
	select SENSOR_ASYNC_API
	select RTIO
	help
	  This option enables the ZROS Argus Stream driver interface

if ZROS_SENSE_STREAM_ARGUS

choice ZROS_SENSE_STREAM_ARGUS_DATA
	prompt "Argus Data Mode"
	default ZROS_SENSE_STREAM_ARGUS_DISTANCE

config ZROS_SENSE_STREAM_ARGUS_DISTANCE
	bool "Enable Basic Argus data (1D)"

config ZROS_SENSE_STREAM_ARGUS_POINTCLOUD
	bool "Enable PointCloud Argus data (3D)"

config ZROS_SENSE_STREAM_ARGUS_VERBOSE
	bool "Enable verbose Argus data (All)"

endchoice

module = ZROS_SENSE_STREAM_ARGUS
module-str = sense_stream_argus
source "subsys/logging/Kconfig.template.log_config"

endif
```

## drivers/sense/stream/distance/Kconfig
```kconfig
# Copyright (c) 2023 CogniPilot Foundation
# Copyright (c) 2025 Croxel Inc.
# SPDX-License-Identifier: Apache-2.0

config ZROS_SENSE_STREAM_DISTANCE
	bool "ZROS Distance Stream driver"
	select SENSOR
	select SENSOR_ASYNC_API
	select RTIO
	help
	  This option enables the ZROS Distance Stream driver interface

if ZROS_SENSE_STREAM_DISTANCE

module = ZROS_SENSE_STREAM_DISTANCE
module-str = sense_stream_distance
source "subsys/logging/Kconfig.template.log_config"

endif
```

## drivers/sense/stream/imu/Kconfig
```kconfig
# Copyright (c) 2023 CogniPilot Foundation
# Copyright (c) 2025 Croxel Inc.
# SPDX-License-Identifier: Apache-2.0

config ZROS_SENSE_STREAM_IMU
	bool "ZROS IMU Stream driver"
	select SENSOR
	select SENSOR_ASYNC_API
	select SENSOR_THREE_AXIS_REF
	select RTIO
	help
	  This option enables the ZROS IMU Stream driver interface

if ZROS_SENSE_STREAM_IMU

config ZROS_SENSE_STREAM_IMU_DRDY_MODE
	bool "Use DRDY trigger instead of FIFO watermark"
	default n
	help
	  When enabled, the IMU stream driver uses SENSOR_TRIG_DATA_READY
	  instead of SENSOR_TRIG_FIFO_WATERMARK. This provides lower latency
	  by reading samples directly from the sensor data registers on each
	  data-ready interrupt, bypassing the FIFO.

	  Note: The sensor driver must support DRDY-based streaming for this
	  to work (e.g., ICM4268X with interrupt1-drdy enabled in devicetree).

module = ZROS_SENSE_STREAM_IMU
module-str = sense_stream_imu
source "subsys/logging/Kconfig.template.log_config"

endif
```

## drivers/sense/stream/mag/Kconfig
```kconfig
# Copyright (c) 2023 CogniPilot Foundation
# Copyright (c) 2025 Croxel Inc.
# SPDX-License-Identifier: Apache-2.0

config ZROS_SENSE_STREAM_MAG
	bool "ZROS MAG Stream driver"
	select SENSOR
	select SENSOR_ASYNC_API
	select SENSOR_THREE_AXIS_REF
	select RTIO
	help
	  This option enables the ZROS MAG Stream driver interface

if ZROS_SENSE_STREAM_MAG

module = ZROS_SENSE_STREAM_MAG
module-str = sense_stream_mag
source "subsys/logging/Kconfig.template.log_config"

endif
```

## drivers/sense/stream/optical_flow/Kconfig
```kconfig
# Copyright (c) 2023 CogniPilot Foundation
# Copyright (c) 2025 Croxel Inc.
# SPDX-License-Identifier: Apache-2.0

config ZROS_SENSE_STREAM_OPTICAL_FLOW
	bool "ZROS IMU Stream driver"
	select SENSOR
	select SENSOR_ASYNC_API
	select RTIO
	help
	  This option enables the ZROS Optical Flow Stream driver interface

if ZROS_SENSE_STREAM_OPTICAL_FLOW

module = ZROS_SENSE_STREAM_OPTICAL_FLOW
module-str = sense_stream_optical_flow
source "subsys/logging/Kconfig.template.log_config"

endif
```

## lib/Kconfig
```kconfig
# Copyright (c) 2025 Croxel Inc.
# SPDX-License-Identifier: Apache-2.0

rsource "perf/Kconfig"
```

## lib/perf/Kconfig
```kconfig
config ZROS_PERF
	bool "Enable ZROS Perf utilities"
	default y
	depends on ZROS
	help
	  ZROS Perf utilities allow characterizing performance of ZROS nodes.
```
